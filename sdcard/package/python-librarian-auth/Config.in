## sdcard/package/python-librarian-auth/Config.in
```kconfig
config BR2_PACKAGE_PYTHON_LIBRARIAN_AUTH
	bool "python-librarian-auth"
	depends on BR2_PACKAGE_PYTHON || BR2_PACKAGE_PYTHON3
    select BR2_PACKAGE_PYTHON_LIBRARIAN_CORE
	help
      Librarian authentication system

	  https://github.com/Outernet-Project/librarian-auth/
```

## sdcard/package/python-librarian-captive/Config.in
```kconfig
config BR2_PACKAGE_PYTHON_LIBRARIAN_CAPTIVE
	bool "python-librarian-captive"
	depends on BR2_PACKAGE_PYTHON || BR2_PACKAGE_PYTHON3
    select BR2_PACKAGE_PYTHON_LIBRARIAN_CORE
	help
      Librarian captive portal support

	  https://github.com/Outernet-Project/librarian-captive/
```

## sdcard/package/python-librarian-content/Config.in
```kconfig
config BR2_PACKAGE_PYTHON_LIBRARIAN_CONTENT
	bool "python-librarian-content"
	depends on BR2_PACKAGE_PYTHON || BR2_PACKAGE_PYTHON3
    select BR2_PACKAGE_PYTHON_LIBRARIAN_CORE
    select BR2_PACKAGE_PYTHON_FSAL
	help
      Librarian content management base API

	  https://github.com/Outernet-Project/librarian-content/
```

## sdcard/package/python-librarian-core/Config.in
```kconfig
config BR2_PACKAGE_PYTHON_LIBRARIAN_CORE
	bool "python-librarian-core"
	depends on BR2_PACKAGE_PYTHON || BR2_PACKAGE_PYTHON3
	select BR2_PACKAGE_PYTHON_BOTTLE
	select BR2_PACKAGE_PYTHON_BOTTLE_FDSEND
	select BR2_PACKAGE_PYTHON_BOTTLE_UTILS
	select BR2_PACKAGE_PYTHON_CHAINABLE_VALIDATORS
	select BR2_PACKAGE_PYTHON_CSSMIN
	select BR2_PACKAGE_PYTHON_DATEUTIL
	select BR2_PACKAGE_PYTHON_GEVENT
	select BR2_PACKAGE_PYTHON_GREENTASKS
	select BR2_PACKAGE_PYTHON_MAKO
	select BR2_PACKAGE_PYTHON_OUTERNET_METADATA
	select BR2_PACKAGE_PYTHON_PBKDF2
	select BR2_PACKAGE_PYTHON_PYTZ
	select BR2_PACKAGE_PYTHON_SQUERY_PG
	select BR2_PACKAGE_PYTHON_SQLIZE_PG
	select BR2_PACKAGE_PYTHON_WEBASSETS
	help
	  Librarian core

	  https://github.com/Outernet-Project/librarian-core/
```

## sdcard/package/python-librarian-filemanager/Config.in
```kconfig
config BR2_PACKAGE_PYTHON_LIBRARIAN_FILEMANAGER
	bool "python-librarian-filemanager"
	depends on BR2_PACKAGE_PYTHON || BR2_PACKAGE_PYTHON3
    select BR2_PACKAGE_PYTHON_LIBRARIAN_CORE
    select BR2_PACKAGE_PYTHON_LIBRARIAN_CONTENT
	help
      Librarian file management app 

	  https://github.com/Outernet-Project/librarian-filemanager/
```

## sdcard/package/python-librarian-netinterfaces/Config.in
```kconfig
config BR2_PACKAGE_PYTHON_LIBRARIAN_NETINTERFACES
	bool "python-librarian-netinterfaces"
	depends on BR2_PACKAGE_PYTHON || BR2_PACKAGE_PYTHON3
	select BR2_PACKAGE_PYTHON_LIBRARIAN_CORE
	select BR2_PACKAGE_PYTHON_LIBRARIAN_DASHBOARD
	select BR2_PACKAGE_PYTHON_HWD
	select BR2_PACKAGE_PYTHON_PYHOSTAPDCONF
	help
	  Librarian network interface configuration

	  https://github.com/Outernet-Project/librarian-netinterfaces/
```

## sdcard/package/python-librarian-ondd/Config.in
```kconfig
config BR2_PACKAGE_PYTHON_LIBRARIAN_ONDD
	bool "python-librarian-ondd"
	depends on BR2_PACKAGE_PYTHON || BR2_PACKAGE_PYTHON3
	select BR2_PACKAGE_PYTHON_LIBRARIAN_CORE
	select BR2_PACKAGE_PYTHON_LIBRARIAN_DASHBOARD
	select BR2_PACKAGE_PYTHON_ONDD_IPC
	help
	  Librarian ONDD (tuner) configuration

	  https://github.com/Outernet-Project/librarian-ondd/
```

## sdcard/package/python-librarian-opener-html/Config.in
```kconfig
config BR2_PACKAGE_PYTHON_LIBRARIAN_OPENER_HTML
	bool "python-librarian-opener-html"
	depends on BR2_PACKAGE_PYTHON || BR2_PACKAGE_PYTHON3
    select BR2_PACKAGE_PYTHON_LIBRARIAN_CORE
    select BR2_PACKAGE_PYTHON_LIBRARIAN_FILEMANAGER
	help
      Librarian opener for HTML content

	  https://github.com/Outernet-Project/librarian-opener-html/
```

## sdcard/package/python-librarian-settings/Config.in
```kconfig
config BR2_PACKAGE_PYTHON_LIBRARIAN_SETTINGS
	bool "python-librarian-settings"
	depends on BR2_PACKAGE_PYTHON || BR2_PACKAGE_PYTHON3
	select BR2_PACKAGE_PYTHON_LIBRARIAN_CORE
	select BR2_PACKAGE_PYTHON_LIBRARIAN_SETUP
	select BR2_PACKAGE_PYTHON_LIBRARIAN_DASHBOARD
	help
	  Librarian settings framework

	  https://github.com/Outernet-Project/librarian-settings/
```

## sdcard/package/python-librarian-setup/Config.in
```kconfig
config BR2_PACKAGE_PYTHON_LIBRARIAN_SETUP
	bool "python-librarian-setup"
	depends on BR2_PACKAGE_PYTHON || BR2_PACKAGE_PYTHON3
    select BR2_PACKAGE_PYTHON_LIBRARIAN_CORE
	help
      Librarian setup wizard

	  https://github.com/Outernet-Project/librarian-setup/
```

## sdcard/package/python-librarian-twitter/Config.in
```kconfig
config BR2_PACKAGE_PYTHON_LIBRARIAN_TWITTER
	bool "python-librarian-twitter"
	depends on BR2_PACKAGE_PYTHON || BR2_PACKAGE_PYTHON3
    select BR2_PACKAGE_PYTHON_LIBRARIAN_CORE
    select BR2_PACKAGE_PYTHON_LIBRARIAN_CONTENT
	help
      Librarian Twitter app 

	  https://github.com/Outernet-Project/librarian-twitter/
```

## sdcard/package/python-librarian/Config.in
```kconfig
config BR2_PACKAGE_PYTHON_LIBRARIAN
	bool "python-librarian"
	depends on BR2_PACKAGE_PYTHON || BR2_PACKAGE_PYTHON3
    select BR2_PACKAGE_PYTHON_LIBRARIAN_CORE
    select BR2_PACKAGE_PYTHON_LIBRARIAN_AUTH
    select BR2_PACKAGE_PYTHON_LIBRARIAN_CONTENT
    select BR2_PACKAGE_PYTHON_LIBRARIAN_DASHBOARD
    select BR2_PACKAGE_PYTHON_LIBRARIAN_MENU
    select BR2_PACKAGE_PYTHON_LIBRARIAN_NOTIFICATIONS
    select BR2_PACKAGE_PYTHON_LIBRARIAN_SETUP
	help
      Content library manager for Outernet Receiver

	  https://github.com/Outernet-Project/librarian/
```

## sdcard/package/python-outernet-metadata/Config.in
```kconfig
config BR2_PACKAGE_PYTHON_OUTERNET_METADATA
	bool "python-outernet-metadata"
	depends on BR2_PACKAGE_PYTHON || BR2_PACKAGE_PYTHON3
    select BR2_PACKAGE_PYTHON_CHAINABLE_VALIDATORS
	help
	  Library for validating Outernet metadata

	  https://github.com/Outernet-Project/outernet-metadata/
```

## sdcard/package/python-pyhostapdconf/Config.in
```kconfig
config BR2_PACKAGE_PYTHON_PYHOSTAPDCONF
	bool "python-pyhostapdconf"
	depends on BR2_PACKAGE_PYTHON || BR2_PACKAGE_PYTHON3
	help
	  Hostapd configuration parser/generator with helper functions for common
	  setups

	  https://github.com/Outernet-Project/pyhostapdconf
```

## sdcard/package/python-pytz/Config.in
```kconfig
config BR2_PACKAGE_PYTHON_PYTZ
	bool "python-pytz"
	depends on BR2_PACKAGE_PYTHON
	help
	  World Timezone Definitions for Python

	  http://pythonhosted.org/pytz
```

## sdcard/package/python-pyudev/Config.in
```kconfig
config BR2_PACKAGE_PYTHON_PYUDEV
	bool "python-pyudev"
	depends on BR2_PACKAGE_PYTHON
	select BR2_PACKAGE_EUDEV
	help
        pyudev is a LGPL licensed, pure Python binding for libudev, the device
        and hardware management and information library for Linux.
```

## sdcard/package/python-squery-pg/Config.in
```kconfig
config BR2_PACKAGE_PYTHON_SQUERY_PG
	bool "python-squery-pg"
	depends on BR2_PACKAGE_PYTHON || BR2_PACKAGE_PYTHON3
	help
	  Ligthweight SQL database management library

	  https://github.com/Outernet-project/squery-pg
```

## sdcard/package/python-user-agents/Config.in
```kconfig
config BR2_PACKAGE_PYTHON_USER_AGENTS
	bool "python-user-agents"
	depends on BR2_PACKAGE_PYTHON || BR2_PACKAGE_PYTHON3
	select BR2_PACKAGE_PYTHON_UA_PARSER
	help
	  A Python library that provides an easy way to identify devices like
	  mobile phones, tablets and their capabilities by parsing (browser) user
	  agent strings. 

	  https://github.com/selwin/python-user-agents
```

## sdcard/package/python-webassets/Config.in
```kconfig
config BR2_PACKAGE_PYTHON_WEBASSETS
	bool "python-webassets"
	help
        Merges, minifies and compresses Javascript and CSS files, supporting a
        variety of different filters, including YUI, jsmin, jspacker or CSS
        tidy. Also supports URL rewriting in CSS files.

        http://github.com/miracle2k/webassets/
```

## sdcard/package/rt8192cu/Config.in
```kconfig
config BR2_PACKAGE_RT8192CU
	bool "rt8192cu"
	depends on BR2_LINUX_KERNEL
	help
	  Realtek driver for 8192cu / 8188cu devices.

	  This driver is only required if you wish to use the WiFi adaptors with 
	  patched hostapd in Master mode (AP mode).

	  https://github.com/dz0ny/rt8192cu

comment "rt8192cu needs a Linux kernel to be built"
	depends on !BR2_LINUX_KERNEL
```
