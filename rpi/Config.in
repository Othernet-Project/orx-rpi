## rpi/package/python-bottle-utils-i18n/Config.in
```kconfig
config BR2_PACKAGE_PYTHON_BOTTLE_UTILS_I18N
	bool "python-bottle-utils-i18n"
	depends on BR2_PACKAGE_PYTHON_BOTTLE
	select BR2_PACKAGE_PYTHON_BOTTLE_UTILS_COMMON
	select BR2_PACKAGE_PYTHON_BOTTLE_UTILS_LAZY
	help
	  Bottle Utils is a collection of loosely related packages for
	  developing web applications using Bottle web framework. This
	  package contains translations utiltiies.

	  http://outernet-project.github.io/bottle-utils/
```

## rpi/package/python-bottle-utils-lazy/Config.in
```kconfig
config BR2_PACKAGE_PYTHON_BOTTLE_UTILS_LAZY
	bool "python-bottle-utils-lazy"
	depends on BR2_PACKAGE_PYTHON_BOTTLE
	select BR2_PACKAGE_PYTHON_BOTTLE_UTILS_COMMON
	help
	  Bottle Utils is a collection of loosely related packages for
	  developing web applications using Bottle web framework. This
	  package contains utilities for lazy evaluation.

	  http://outernet-project.github.io/bottle-utils/
```

## rpi/package/python-bottle-utils/Config.in
```kconfig
config BR2_PACKAGE_PYTHON_BOTTLE_UTILS
	bool "python-bottle-utils"
	depends on BR2_PACKAGE_PYTHON_BOTTLE
	help
	  Bottle Utils is a collection of loosely related packages for
	  developing web applications using Bottle web framework.

	  http://bottle-utils.readthedocs.org/
```

## rpi/package/python-fsal/Config.in
```kconfig
config BR2_PACKAGE_PYTHON_FSAL
	bool "python-fsal"
	depends on BR2_PACKAGE_PYTHON || BR2_PACKAGE_PYTHON3
	select BR2_PACKAGE_PYTHON_SCANDIR
	select BR2_PACKAGE_PYTHON_SQUERY_PG
	select BR2_PACKAGE_PYTHON_SQLIZE_PG
	select BR2_PACKAGE_PYTHON_DATEUTIL
	select BR2_PACKAGE_PYTHON_GEVENT
	select BR2_PACKAGE_PYTHON_SETUPTOOLS
	help
	  Librarian core

	  https://github.com/Outernet-Project/librarian-core/
```

## rpi/package/python-gevent/Config.in
```kconfig
config BR2_PACKAGE_PYTHON_GEVENT
	bool "python-gevent"
	depends on BR2_PACKAGE_PYTHON || BR2_PACKAGE_PYTHON3
	select BR2_PACKAGE_LIBEV
	select BR2_PACKAGE_PYTHON_GREENLET
	help
	  gevent is a coroutine-based Python networking library that uses greenlet
	  to provide a high-level synchronous API on top of the libev event loop.

	  http://www.gevent.org/
```

## rpi/package/python-librarian-analytics/Config.in
```kconfig
config BR2_PACKAGE_PYTHON_LIBRARIAN_ANALYTICS
	bool "python-librarian-analytics"
	depends on BR2_PACKAGE_PYTHON || BR2_PACKAGE_PYTHON3
	select BR2_PACKAGE_PYTHON_LIBRARIAN_CORE
	select BR2_PACKAGE_PYTHON_USER_AGENTS
	help
	  Librarian content usage analytics

	  https://github.com/Outernet-Project/librarian-analytics/
```

## rpi/package/python-librarian-dashboard/Config.in
```kconfig
config BR2_PACKAGE_PYTHON_LIBRARIAN_DASHBOARD
	bool "python-librarian-dashboard"
	depends on BR2_PACKAGE_PYTHON || BR2_PACKAGE_PYTHON3
    select BR2_PACKAGE_PYTHON_LIBRARIAN_CORE
	help
      Librarian settings dashboard

	  https://github.com/Outernet-Project/librarian-dashboard/
```

## rpi/package/python-librarian-diskspace/Config.in
```kconfig
config BR2_PACKAGE_PYTHON_LIBRARIAN_DISKSPACE
	bool "python-librarian-diskspace"
	depends on BR2_PACKAGE_PYTHON || BR2_PACKAGE_PYTHON3
    select BR2_PACKAGE_PYTHON_LIBRARIAN_CORE
    select BR2_PACKAGE_PYTHON_LIBRARIAN_DASHBOARD
    select BR2_PACKAGE_PYTHON_HWD
	help
      Librarian storage configuration

	  https://github.com/Outernet-Project/librarian-diskspace/
```

## rpi/package/python-librarian-logs/Config.in
```kconfig
config BR2_PACKAGE_PYTHON_LIBRARIAN_LOGS
	bool "python-librarian-logs"
	depends on BR2_PACKAGE_PYTHON || BR2_PACKAGE_PYTHON3
    select BR2_PACKAGE_PYTHON_LIBRARIAN_CORE
    select BR2_PACKAGE_PYTHON_LIBRARIAN_DASHBOARD
	help
      Librarian log viewer

	  https://github.com/Outernet-Project/librarian-logs/
```

## rpi/package/python-librarian-menu/Config.in
```kconfig
config BR2_PACKAGE_PYTHON_LIBRARIAN_MENU
	bool "python-librarian-menu"
	depends on BR2_PACKAGE_PYTHON || BR2_PACKAGE_PYTHON3
    select BR2_PACKAGE_PYTHON_LIBRARIAN_CORE
	help
      Librarian menu system

	  https://github.com/Outernet-Project/librarian-menu/
```

## rpi/package/python-librarian-notifications/Config.in
```kconfig
config BR2_PACKAGE_PYTHON_LIBRARIAN_NOTIFICATIONS
	bool "python-librarian-notifications"
	depends on BR2_PACKAGE_PYTHON || BR2_PACKAGE_PYTHON3
    select BR2_PACKAGE_PYTHON_LIBRARIAN_CORE
	help
      Librarian notifications system

	  https://github.com/Outernet-Project/librarian-notifications/
```

## rpi/package/python-librarian-ondd/Config.in
```kconfig
config BR2_PACKAGE_PYTHON_LIBRARIAN_ONDD
	bool "python-librarian-ondd"
	depends on BR2_PACKAGE_PYTHON || BR2_PACKAGE_PYTHON3
    select BR2_PACKAGE_PYTHON_LIBRARIAN_CORE
    select BR2_PACKAGE_PYTHON_LIBRARIAN_DASHBOARD
	help
      Librarian ONDD (tuner) configuration

	  https://github.com/Outernet-Project/librarian-ondd/
```

## rpi/package/python-librarian-opener-video/Config.in
```kconfig
config BR2_PACKAGE_PYTHON_LIBRARIAN_OPENER_VIDEO
	bool "python-librarian-opener-video"
	depends on BR2_PACKAGE_PYTHON || BR2_PACKAGE_PYTHON3
    select BR2_PACKAGE_PYTHON_LIBRARIAN_CORE
    select BR2_PACKAGE_PYTHON_LIBRARIAN_FILEMANAGER
	help
      Librarian opener for video content

	  https://github.com/Outernet-Project/librarian-opener-video/
```

## rpi/package/python-librarian-ui/Config.in
```kconfig
config BR2_PACKAGE_PYTHON_LIBRARIAN_UI
	bool "python-librarian-ui"
	depends on BR2_PACKAGE_PYTHON || BR2_PACKAGE_PYTHON3
    select BR2_PACKAGE_PYTHON_LIBRARIAN_CORE
	help
      Librarian UI toolkit and base templates

	  https://github.com/Outernet-Project/librarian-ui/
```

## rpi/package/python-librarian/Config.in
```kconfig
config BR2_PACKAGE_PYTHON_LIBRARIAN
	bool "python-librarian"
	depends on BR2_PACKAGE_PYTHON || BR2_PACKAGE_PYTHON3
    select BR2_PACKAGE_PYTHON_BOTTLE
    select BR2_PACKAGE_PYTHON_CHAINABLE_VALIDATORS
    select BR2_PACKAGE_PYTHON_GEVENT
    select BR2_PACKAGE_PYTHON_BOTTLE_UTILS_AJAX
    select BR2_PACKAGE_PYTHON_BOTTLE_UTILS_I18N
    select BR2_PACKAGE_PYTHON_BOTTLE_UTILS_CSRF
    select BR2_PACKAGE_PYTHON_BOTTLE_UTILS_FORM
    select BR2_PACKAGE_PYTHON_BOTTLE_FDSEND
    select BR2_PACKAGE_PYTHON_SCANDIR
    select BR2_PACKAGE_PYTHON_MAKO
    select BR2_PACKAGE_PYTHON_OUTERNET_METADATA
    select BR2_PACKAGE_PYTHON_PYTZ
    select BR2_PACKAGE_PYTHON_DATEUTIL
    select BR2_PACKAGE_PYTHON_SQLIZE
    select BR2_PACKAGE_PYTHON_PBKDF2
    select BR2_PACKAGE_PYTHON_WEBASSETS
	help
      Content library manager for Outernet Receiver

	  https://github.com/Outernet-Project/librarian/
```
