## rpi/Config.in
```kconfig
menu "Librarian"
	source "$BR2_EXTERNAL/package/python-librarian/Config.in"
if BR2_PACKAGE_PYTHON_LIBRARIAN
comment "Base framework"
	source "$BR2_EXTERNAL/package/python-librarian-core/Config.in"
	source "$BR2_EXTERNAL/package/python-librarian-notifications/Config.in"
	source "$BR2_EXTERNAL/package/python-librarian-content/Config.in"
	source "$BR2_EXTERNAL/package/python-librarian-setup/Config.in"
	source "$BR2_EXTERNAL/package/python-librarian-auth/Config.in"
	source "$BR2_EXTERNAL/package/python-librarian-dashboard/Config.in"
	source "$BR2_EXTERNAL/package/python-librarian-menu/Config.in"
comment "UI skins"
	source "$BR2_EXTERNAL/package/python-librarian-ui/Config.in"
comment "Settings plugins"
	source "$BR2_EXTERNAL/package/python-librarian-logs/Config.in"
	source "$BR2_EXTERNAL/package/python-librarian-ondd/Config.in"
	source "$BR2_EXTERNAL/package/python-librarian-diskspace/Config.in"
	source "$BR2_EXTERNAL/package/python-librarian-netinterfaces/Config.in"
comment "Apps"
	source "$BR2_EXTERNAL/package/python-librarian-filemanager/Config.in"
	source "$BR2_EXTERNAL/package/python-librarian-library/Config.in"
	source "$BR2_EXTERNAL/package/python-librarian-twitter/Config.in"
comment "Content openers"
	source "$BR2_EXTERNAL/package/python-librarian-opener-html/Config.in"
	source "$BR2_EXTERNAL/package/python-librarian-opener-video/Config.in"
comment "Misc"
	source "$BR2_EXTERNAL/package/python-librarian-captive/Config.in"
endif
comment "Monitoring and reporting"
	source "$BR2_EXTERNAL/package/monitoring/Config.in"
endmenu

menu "ONDD"
comment "ONDD package is a placeholder. You normally do not want to enable it."
comment "If you enable the ONDD package, you must manually download and place"
comment "the srouce tarball into buildroot/dl."
	source "$BR2_EXTERNAL/package/ondd/Config.in"
endmenu

menu "Dependencies"
    source "$BR2_EXTERNAL/package/python-bottle-fdsend/Config.in"
    source "$BR2_EXTERNAL/package/python-bottle-utils/Config.in"
    source "$BR2_EXTERNAL/package/python-chainable-validators/Config.in"
    source "$BR2_EXTERNAL/package/python-cssmin/Config.in"
    source "$BR2_EXTERNAL/package/python-dateutil/Config.in"
    source "$BR2_EXTERNAL/package/python-fsal/Config.in"
    source "$BR2_EXTERNAL/package/python-gevent/Config.in"
    source "$BR2_EXTERNAL/package/python-greenlet/Config.in"
    source "$BR2_EXTERNAL/package/python-hwd/Config.in"
    source "$BR2_EXTERNAL/package/python-outernet-metadata/Config.in"
    source "$BR2_EXTERNAL/package/python-pbkdf2/Config.in"
    source "$BR2_EXTERNAL/package/python-pytz/Config.in"
    source "$BR2_EXTERNAL/package/python-pyudev/Config.in"
    source "$BR2_EXTERNAL/package/python-scandir/Config.in"
    source "$BR2_EXTERNAL/package/python-sqlize/Config.in"
    source "$BR2_EXTERNAL/package/python-webassets/Config.in"
endmenu
```

## rpi/configs/kernel_defconfig
```kconfig
# CONFIG_LOCALVERSION_AUTO is not set
CONFIG_DEFAULT_HOSTNAME="orxpi"
# CONFIG_SWAP is not set
CONFIG_SYSVIPC=y
CONFIG_POSIX_MQUEUE=y
CONFIG_NO_HZ=y
CONFIG_HIGH_RES_TIMERS=y
CONFIG_IKCONFIG=y
CONFIG_IKCONFIG_PROC=y
CONFIG_BLK_DEV_INITRD=y
CONFIG_INITRAMFS_SOURCE="${BR_BINARIES_DIR}/rootfs.cpio"
CONFIG_KALLSYMS_ALL=y
CONFIG_EMBEDDED=y
CONFIG_PERF_EVENTS=y
# CONFIG_COMPAT_BRK is not set
CONFIG_SLAB=y
CONFIG_MODULES=y
CONFIG_MODULE_UNLOAD=y
CONFIG_MODVERSIONS=y
CONFIG_MODULE_SRCVERSION_ALL=y
# CONFIG_BLK_DEV_BSG is not set
CONFIG_ARCH_BCM2708=y
CONFIG_BCM2708_DT=y
CONFIG_AEABI=y
CONFIG_CMA=y
CONFIG_UACCESS_WITH_MEMCPY=y
CONFIG_ZBOOT_ROM_TEXT=0x0
CONFIG_ZBOOT_ROM_BSS=0x0
CONFIG_CMDLINE="dwc_otg.lpm_enable=0 console=ttyAMA0,115200 kgdboc=ttyAMA0,115200"
CONFIG_CPU_FREQ=y
CONFIG_CPU_FREQ_DEFAULT_GOV_POWERSAVE=y
CONFIG_CPU_FREQ_GOV_PERFORMANCE=y
CONFIG_CPU_FREQ_GOV_USERSPACE=y
CONFIG_CPU_FREQ_GOV_ONDEMAND=y
CONFIG_CPU_FREQ_GOV_CONSERVATIVE=y
CONFIG_VFP=y
CONFIG_BINFMT_MISC=y
CONFIG_NET=y
CONFIG_PACKET=y
CONFIG_UNIX=y
CONFIG_INET=y
CONFIG_IP_MULTICAST=y
CONFIG_SYN_COOKIES=y
# CONFIG_INET_XFRM_MODE_TRANSPORT is not set
# CONFIG_INET_XFRM_MODE_TUNNEL is not set
# CONFIG_INET_XFRM_MODE_BEET is not set
# CONFIG_INET_LRO is not set
# CONFIG_INET_DIAG is not set
# CONFIG_IPV6 is not set
CONFIG_NETFILTER=y
CONFIG_IP_NF_IPTABLES=y
CONFIG_IP_NF_FILTER=y
CONFIG_CFG80211=y
CONFIG_CFG80211_WEXT=y
CONFIG_MAC80211=y
CONFIG_RFKILL=y
CONFIG_RFKILL_INPUT=y
CONFIG_RFKILL_GPIO=m
CONFIG_DEVTMPFS=y
CONFIG_DEVTMPFS_MOUNT=y
CONFIG_DMA_CMA=y
CONFIG_CMA_SIZE_MBYTES=5
CONFIG_BLK_DEV_LOOP=y
CONFIG_BLK_DEV_RAM=y
CONFIG_SCSI=y
CONFIG_BLK_DEV_SD=y
# CONFIG_SCSI_LOWLEVEL is not set
CONFIG_NETDEVICES=y
# CONFIG_ETHERNET is not set
CONFIG_USB_USBNET=y
# CONFIG_USB_NET_AX8817X is not set
# CONFIG_USB_NET_CDCETHER is not set
# CONFIG_USB_NET_CDC_NCM is not set
CONFIG_USB_NET_SMSC95XX=y
# CONFIG_USB_NET_NET1080 is not set
# CONFIG_USB_NET_CDC_SUBSET is not set
# CONFIG_USB_NET_ZAURUS is not set
CONFIG_RTL8187=m
CONFIG_ATH_CARDS=m
CONFIG_ATH9K=m
CONFIG_ATH9K_HTC=m
CONFIG_CARL9170=m
CONFIG_CARL9170_HWRNG=y
CONFIG_AR5523=m
CONFIG_ATH10K=m
CONFIG_WCN36XX=m
CONFIG_B43LEGACY=m
CONFIG_RT2X00=m
CONFIG_RT2500USB=m
CONFIG_RT73USB=m
CONFIG_RT2800USB=m
CONFIG_RT2800USB_RT3573=y
CONFIG_RT2800USB_RT53XX=y
CONFIG_RT2800USB_RT55XX=y
CONFIG_RT2800USB_UNKNOWN=y
CONFIG_RTL8192CU=m
# CONFIG_INPUT_MOUSEDEV is not set
CONFIG_INPUT_EVDEV=y
# CONFIG_INPUT_KEYBOARD is not set
# CONFIG_INPUT_MOUSE is not set
# CONFIG_SERIO is not set
# CONFIG_LEGACY_PTYS is not set
# CONFIG_DEVKMEM is not set
CONFIG_SERIAL_AMBA_PL011=y
CONFIG_SERIAL_AMBA_PL011_CONSOLE=y
CONFIG_TTY_PRINTK=y
CONFIG_HW_RANDOM=y
CONFIG_HW_RANDOM_BCM2708=y
CONFIG_RAW_DRIVER=y
CONFIG_BCM_VC_SM=y
CONFIG_I2C=y
# CONFIG_I2C_COMPAT is not set
CONFIG_I2C_CHARDEV=y
CONFIG_I2C_MUX=y
CONFIG_I2C_BCM2835=m
CONFIG_I2C_BCM2708=m
CONFIG_SPI=y
CONFIG_SPI_BCM2835=m
CONFIG_SPI_BCM2708=m
CONFIG_SPI_SPIDEV=y
CONFIG_GPIO_SYSFS=y
CONFIG_POWER_SUPPLY=y
# CONFIG_HWMON is not set
CONFIG_THERMAL=m
CONFIG_THERMAL_BCM2835=m
CONFIG_WATCHDOG=y
CONFIG_BCM2708_WDT=y
CONFIG_BCMA=m
CONFIG_MEDIA_SUPPORT=m
CONFIG_MEDIA_CAMERA_SUPPORT=y
CONFIG_MEDIA_DIGITAL_TV_SUPPORT=y
CONFIG_MEDIA_RC_SUPPORT=y
CONFIG_MEDIA_CONTROLLER=y
# CONFIG_DVB_NET is not set
# CONFIG_RC_DECODERS is not set
CONFIG_MEDIA_USB_SUPPORT=y
CONFIG_DVB_USB=m
CONFIG_DVB_USB_TTUSB2=m
CONFIG_DVB_USB_OPERA1=m
CONFIG_DVB_USB_PCTV452E=m
CONFIG_DVB_USB_DW2102=m
CONFIG_DVB_USB_AZ6027=m
CONFIG_DVB_USB_TECHNISAT_USB2=m
CONFIG_DVB_USB_V2=m
CONFIG_DVB_USB_DVBSKY=m
CONFIG_VIDEO_EM28XX=m
CONFIG_VIDEO_EM28XX_V4L2=m
CONFIG_VIDEO_EM28XX_DVB=m
CONFIG_FB=y
CONFIG_FB_BCM2708=y
CONFIG_FRAMEBUFFER_CONSOLE=y
CONFIG_USB=y
CONFIG_USB_ANNOUNCE_NEW_DEVICES=y
CONFIG_USB_DWCOTG=y
CONFIG_USB_STORAGE=y
CONFIG_USB_UAS=m
CONFIG_NOP_USB_XCEIV=y
CONFIG_USB_LED_TRIG=y
CONFIG_MMC=y
CONFIG_MMC_BCM2835=y
CONFIG_LEDS_CLASS=y
CONFIG_LEDS_TRIGGER_TIMER=y
CONFIG_DMADEVICES=y
CONFIG_DMA_BCM2708=m
CONFIG_UIO=m
CONFIG_UIO_PDRV_GENIRQ=m
CONFIG_STAGING=y
CONFIG_RTLLIB=m
CONFIG_R8712U=m
CONFIG_R8188EU=m
# CONFIG_IOMMU_SUPPORT is not set
CONFIG_EXT2_FS=y
CONFIG_EXT2_FS_XATTR=y
CONFIG_EXT2_FS_SECURITY=y
CONFIG_EXT3_FS=m
CONFIG_EXT4_FS=y
CONFIG_EXT4_FS_POSIX_ACL=y
CONFIG_EXT4_FS_SECURITY=y
CONFIG_REISERFS_FS=m
CONFIG_JFS_FS=m
CONFIG_AUTOFS4_FS=y
CONFIG_FUSE_FS=m
CONFIG_OVERLAY_FS=m
CONFIG_FSCACHE=y
CONFIG_CACHEFILES=y
CONFIG_MSDOS_FS=y
CONFIG_VFAT_FS=y
CONFIG_FAT_DEFAULT_IOCHARSET="ascii"
CONFIG_NTFS_FS=m
CONFIG_NTFS_RW=y
CONFIG_TMPFS=y
CONFIG_TMPFS_POSIX_ACL=y
CONFIG_CONFIGFS_FS=y
# CONFIG_MISC_FILESYSTEMS is not set
CONFIG_NFS_FS=y
CONFIG_NFS_V3_ACL=y
CONFIG_NFS_V4=y
CONFIG_NFS_FSCACHE=y
CONFIG_NLS_DEFAULT="utf8"
CONFIG_NLS_CODEPAGE_437=y
CONFIG_NLS_CODEPAGE_737=y
CONFIG_NLS_CODEPAGE_775=y
CONFIG_NLS_CODEPAGE_850=y
CONFIG_NLS_CODEPAGE_852=y
CONFIG_NLS_CODEPAGE_855=y
CONFIG_NLS_CODEPAGE_857=y
CONFIG_NLS_CODEPAGE_860=y
CONFIG_NLS_CODEPAGE_861=y
CONFIG_NLS_CODEPAGE_862=y
CONFIG_NLS_CODEPAGE_863=y
CONFIG_NLS_CODEPAGE_864=y
CONFIG_NLS_CODEPAGE_865=y
CONFIG_NLS_CODEPAGE_866=y
CONFIG_NLS_CODEPAGE_869=y
CONFIG_NLS_CODEPAGE_936=y
CONFIG_NLS_CODEPAGE_950=y
CONFIG_NLS_CODEPAGE_932=y
CONFIG_NLS_CODEPAGE_949=y
CONFIG_NLS_CODEPAGE_874=y
CONFIG_NLS_ISO8859_8=y
CONFIG_NLS_CODEPAGE_1250=y
CONFIG_NLS_CODEPAGE_1251=y
CONFIG_NLS_ASCII=y
CONFIG_NLS_ISO8859_1=y
CONFIG_NLS_ISO8859_2=y
CONFIG_NLS_ISO8859_3=y
CONFIG_NLS_ISO8859_4=y
CONFIG_NLS_ISO8859_5=y
CONFIG_NLS_ISO8859_6=y
CONFIG_NLS_ISO8859_7=y
CONFIG_NLS_ISO8859_9=y
CONFIG_NLS_ISO8859_13=y
CONFIG_NLS_ISO8859_14=y
CONFIG_NLS_ISO8859_15=y
CONFIG_NLS_UTF8=y
CONFIG_PRINTK_TIME=y
CONFIG_DETECT_HUNG_TASK=y
# CONFIG_DEBUG_BUGVERBOSE is not set
# CONFIG_FTRACE is not set
CONFIG_KGDB=y
CONFIG_KGDB_KDB=y
# CONFIG_ARM_UNWIND is not set
CONFIG_CRYPTO_CBC=y
CONFIG_CRYPTO_HMAC=y
CONFIG_CRYPTO_MD5=y
CONFIG_CRYPTO_SHA1=y
CONFIG_CRYPTO_SHA256=y
CONFIG_CRYPTO_SHA512=y
CONFIG_CRYPTO_AES_ARM=y
CONFIG_CRYPTO_DES=y
CONFIG_CRYPTO_DEFLATE=y
CONFIG_CRYPTO_ZLIB=y
CONFIG_CRYPTO_LZO=y
CONFIG_ASYMMETRIC_KEY_TYPE=y
CONFIG_PUBLIC_KEY_ALGO_RSA=y
CONFIG_CRC_ITU_T=y
CONFIG_LIBCRC32C=y
CONFIG_XZ_DEC=y
CONFIG_CORDIC=m
```

## rpi/configs/orx_defconfig
```kconfig
BR2_arm=y
BR2_arm1176jzf_s=y
BR2_PACKAGE_OVERRIDE_FILE="$(BR2_EXTERNAL)/local.mk"
BR2_GLOBAL_PATCH_DIR="$(BR2_EXTERNAL)/patches"
BR2_KERNEL_HEADERS_4_1=y
BR2_TOOLCHAIN_BUILDROOT_GLIBC=y
BR2_TOOLCHAIN_BUILDROOT_CXX=y
BR2_GENERATE_LOCALE="en_US"
BR2_TARGET_GENERIC_HOSTNAME="orxpi"
BR2_TARGET_GENERIC_ISSUE="Welcome to Outernet"
BR2_ROOTFS_DEVICE_CREATION_DYNAMIC_EUDEV=y
BR2_TARGET_GENERIC_ROOT_PASSWD="outernet"
BR2_SYSTEM_DHCP="eth0"
BR2_TARGET_TZ_INFO=y
BR2_ROOTFS_USERS_TABLES="$(BR2_EXTERNAL)/users"
BR2_ROOTFS_OVERLAY="$(BR2_EXTERNAL)/rootfs_overlay"
BR2_ROOTFS_POST_BUILD_SCRIPT="$(BR2_EXTERNAL)/scripts/post_build.sh $(BR2_EXTERNAL)/scripts/collect_static.sh"
BR2_ROOTFS_POST_IMAGE_SCRIPT="$(BR2_EXTERNAL)/scripts/post_image.sh"
BR2_LINUX_KERNEL=y
BR2_LINUX_KERNEL_CUSTOM_GIT=y
BR2_LINUX_KERNEL_CUSTOM_REPO_URL="https://github.com/raspberrypi/linux.git"
BR2_LINUX_KERNEL_CUSTOM_REPO_VERSION="0aa6fa69a7874060590c8cb4fabdb9a222501a08"
BR2_LINUX_KERNEL_USE_CUSTOM_CONFIG=y
BR2_LINUX_KERNEL_CUSTOM_CONFIG_FILE="$(BR2_EXTERNAL)/configs/kernel_defconfig"
BR2_LINUX_KERNEL_ZIMAGE=y
BR2_LINUX_KERNEL_DTS_SUPPORT=y
BR2_LINUX_KERNEL_INTREE_DTS_NAME="bcm2708-rpi-b bcm2708-rpi-b-plus"
BR2_PACKAGE_BUSYBOX_CONFIG="$(BR2_EXTERNAL)/configs/busybox.config"
BR2_PACKAGE_BZIP2=y
BR2_PACKAGE_INFOZIP=y
BR2_PACKAGE_DOSFSTOOLS=y
BR2_PACKAGE_DOSFSTOOLS_FSCK_FAT=y
BR2_PACKAGE_DOSFSTOOLS_MKFS_FAT=y
BR2_PACKAGE_E2FSPROGS=y
BR2_PACKAGE_NTFS_3G=y
BR2_PACKAGE_B43_FIRMWARE=y
BR2_PACKAGE_LINUX_FIRMWARE=y
BR2_PACKAGE_LINUX_FIRMWARE_ATHEROS_6002=y
BR2_PACKAGE_LINUX_FIRMWARE_ATHEROS_6003=y
BR2_PACKAGE_LINUX_FIRMWARE_ATHEROS_6004=y
BR2_PACKAGE_LINUX_FIRMWARE_ATHEROS_7010=y
BR2_PACKAGE_LINUX_FIRMWARE_ATHEROS_9170=y
BR2_PACKAGE_LINUX_FIRMWARE_ATHEROS_9271=y
BR2_PACKAGE_LINUX_FIRMWARE_BRCM_BCM43XX=y
BR2_PACKAGE_LINUX_FIRMWARE_BRCM_BCM43XXX=y
BR2_PACKAGE_LINUX_FIRMWARE_IWLWIFI_3160=y
BR2_PACKAGE_LINUX_FIRMWARE_IWLWIFI_5000=y
BR2_PACKAGE_LINUX_FIRMWARE_IWLWIFI_6000G2A=y
BR2_PACKAGE_LINUX_FIRMWARE_IWLWIFI_7260=y
BR2_PACKAGE_LINUX_FIRMWARE_IWLWIFI_7265=y
BR2_PACKAGE_LINUX_FIRMWARE_LIBERTAS_SD8686_V8=y
BR2_PACKAGE_LINUX_FIRMWARE_LIBERTAS_SD8686_V9=y
BR2_PACKAGE_LINUX_FIRMWARE_LIBERTAS_SD8688=y
BR2_PACKAGE_LINUX_FIRMWARE_MWIFIEX_SD8787=y
BR2_PACKAGE_LINUX_FIRMWARE_RALINK_RT61=y
BR2_PACKAGE_LINUX_FIRMWARE_RALINK_RT73=y
BR2_PACKAGE_LINUX_FIRMWARE_RALINK_RT2XX=y
BR2_PACKAGE_LINUX_FIRMWARE_RTL_81XX=y
BR2_PACKAGE_LINUX_FIRMWARE_RTL_87XX=y
BR2_PACKAGE_LINUX_FIRMWARE_RTL_88XX=y
BR2_PACKAGE_LINUX_FIRMWARE_TI_WL127X=y
BR2_PACKAGE_LINUX_FIRMWARE_TI_WL128X=y
BR2_PACKAGE_LINUX_FIRMWARE_TI_WL18XX=y
BR2_PACKAGE_RPI_FIRMWARE=y
# BR2_PACKAGE_RPI_FIRMWARE_INSTALL_DTB_OVERLAYS is not set
BR2_PACKAGE_DVB_APPS=y
BR2_PACKAGE_DVBSNOOP=y
BR2_PACKAGE_HWDATA=y
BR2_PACKAGE_PYTHON=y
BR2_PACKAGE_PYTHON_PY_ONLY=y
BR2_PACKAGE_PYTHON_SSL=y
BR2_PACKAGE_PYTHON_SQLITE=y
BR2_PACKAGE_PYTHON_PYEXPAT=y
BR2_PACKAGE_PYTHON_HASHLIB=y
BR2_PACKAGE_PYTHON_MARKUPSAFE=y
BR2_PACKAGE_LIBUSB=y
BR2_PACKAGE_LIBCURL=y
BR2_PACKAGE_CURL=y
BR2_PACKAGE_READLINE=y
BR2_PACKAGE_BC=y
BR2_PACKAGE_SHARED_MIME_INFO=y
BR2_PACKAGE_DNSMASQ=y
BR2_PACKAGE_DROPBEAR=y
BR2_PACKAGE_DROPBEAR_DISABLE_REVERSEDNS=y
BR2_PACKAGE_DROPBEAR_LASTLOG=y
BR2_PACKAGE_HOSTAPD=y
BR2_PACKAGE_IPTABLES=y
BR2_PACKAGE_IW=y
BR2_PACKAGE_LIGHTTPD=y
BR2_PACKAGE_LIGHTTPD_PCRE=y
BR2_PACKAGE_NTP=y
BR2_PACKAGE_SUDO=y
BR2_PACKAGE_CPULOAD=y
BR2_PACKAGE_HTOP=y
BR2_TARGET_ROOTFS_INITRAMFS=y
# BR2_TARGET_ROOTFS_TAR is not set
BR2_PACKAGE_PYTHON_LIBRARIAN=y
BR2_PACKAGE_PYTHON_LIBRARIAN_UI=y
BR2_PACKAGE_PYTHON_LIBRARIAN_LOGS=y
BR2_PACKAGE_PYTHON_LIBRARIAN_ONDD=y
BR2_PACKAGE_PYTHON_LIBRARIAN_DISKSPACE=y
BR2_PACKAGE_PYTHON_LIBRARIAN_NETINTERFACES=y
BR2_PACKAGE_PYTHON_LIBRARIAN_LIBRARY=y
BR2_PACKAGE_PYTHON_LIBRARIAN_TWITTER=y
BR2_PACKAGE_PYTHON_LIBRARIAN_OPENER_HTML=y
BR2_PACKAGE_PYTHON_LIBRARIAN_OPENER_VIDEO=y
BR2_PACKAGE_PYTHON_LIBRARIAN_CAPTIVE=y
BR2_PACKAGE_MONITORING=y
BR2_PACKAGE_PYTHON_PSYCOPG2=y
```

## rpi/package/monitoring/Config.in
```kconfig
config BR2_PACKAGE_MONITORING
	bool "monitoring"
	depends on BR2_PACKAGE_PYTHON
	select BR2_PACKAGE_PYTHON_BITARRAY
	help
	  Client-side script for sending Outernet signal monitoring data to a
	  central server.
	  
	  https://github.com/Outernet-Project/monitoring
```

## rpi/package/ondd/Config.in
```kconfig
config BR2_PACKAGE_ONDD
	bool "ondd"
	select BR2_PACKAGE_OPENSSL
	help
	  Outernet Data Delivery agent
	  
	  http://outernet.is/
```

## rpi/package/python-bitarray/Config.in
```kconfig
config BR2_PACKAGE_PYTHON_BITARRAY
	bool "python-bitarray"
	depends on BR2_PACKAGE_PYTHON || BR2_PACKAGE_PYTHON3
	help
	  This module provides an object type which efficiently represents an array
	  of booleans. Bitarrays are sequence types and behave very much like usual
	  lists.

	  https://github.com/ilanschnell/bitarray/
```

## rpi/package/python-bottle-utils-ajax/Config.in
```kconfig
config BR2_PACKAGE_PYTHON_BOTTLE_UTILS_AJAX
	bool "python-bottle-utils-ajax"
	depends on BR2_PACKAGE_PYTHON_BOTTLE
	help
	  Bottle Utils is a collection of loosely related packages for
	  developing web applications using Bottle web framework. This
	  package contains the AJAX utiltiies.

	  http://outernet-project.github.io/bottle-utils/
```

## rpi/package/python-bottle-utils-common/Config.in
```kconfig
config BR2_PACKAGE_PYTHON_BOTTLE_UTILS_COMMON
	bool "python-bottle-utils-common"
	depends on BR2_PACKAGE_PYTHON_BOTTLE
	select BR2_PACKAGE_PYTHON_DATEUTIL
	help
	  Bottle Utils is a collection of loosely related packages for
	  developing web applications using Bottle web framework. This
	  package contains the common utilities shared by some of the
	  Bottle Utils packages.

	  http://outernet-project.github.io/bottle-utils/
```

## rpi/package/python-bottle-utils-form/Config.in
```kconfig
config BR2_PACKAGE_PYTHON_BOTTLE_UTILS_FORM
	bool "python-bottle-utils-form"
	depends on BR2_PACKAGE_PYTHON_BOTTLE
	select BR2_PACKAGE_PYTHON_DATEUTIL
	select BR2_PACKAGE_PYTHON_BOTTLE_UTILS_COMMON
	select BR2_PACKAGE_PYTHON_BOTTLE_UTILS_HTML
	help
	  Bottle Utils is a collection of loosely related packages for
	  developing web applications using Bottle web framework. This
	  package contains the common utilities shared by some of the
	  Bottle Utils packages.

	  http://outernet-project.github.io/bottle-utils/
```

## rpi/package/python-bottle-utils-html/Config.in
```kconfig
config BR2_PACKAGE_PYTHON_BOTTLE_UTILS_HTML
	bool "python-bottle-utils-html"
	depends on BR2_PACKAGE_PYTHON_BOTTLE
	select BR2_PACKAGE_PYTHON_BOTTLE_UTILS_COMMON
	select BR2_PACKAGE_PYTHON_DATEUTIL
	help
	  Bottle Utils is a collection of loosely related packages for
	  developing web applications using Bottle web framework. This
	  package contains the HTML template utiltiies.

	  http://outernet-project.github.io/bottle-utils/
```
