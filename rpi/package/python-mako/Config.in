## rpi/package/python-mako/Config.in
```kconfig
config BR2_PACKAGE_PYTHON_MAKO
	bool "python-mako"
	depends on BR2_PACKAGE_PYTHON || BR2_PACKAGE_PYTHON3
    select BR2_PACKAGE_PYTHON_MARKUPSAFE
	help
	  Mako is a template library written in Python. It provides a
	  familiar, non-XML syntax which compiles into Python modules
	  for maximum performance.

	  http://www.makotemplates.org/
```

## rpi/package/python-markupsafe/Config.in
```kconfig
config BR2_PACKAGE_PYTHON_MARKUPSAFE
	bool "python-markupsafe"
	depends on BR2_PACKAGE_PYTHON || BR2_PACKAGE_PYTHON3
	help
	  Implements a unicode subclass that supports HTML strings.

	  http://github.com/mitsuhiko/markupsafe
```

## rpi/package/python-ondd-ipc/Config.in
```kconfig
config BR2_PACKAGE_PYTHON_ONDD_IPC
	bool "python-ondd-ipc"
	depends on BR2_PACKAGE_PYTHON || BR2_PACKAGE_PYTHON3
	select BR2_PYTHON_BOTTLE
	help
	  ONDD IPC library

	  https://github.com/Outernet-Project/ondd-ipc/
```

## rpi/package/python-pbkdf2/Config.in
```kconfig
config BR2_PACKAGE_PYTHON_PBKDF2
	bool "python-pbkdf2"
	depends on BR2_PACKAGE_PYTHON || BR2_PACKAGE_PYTHON3
	help
	  This module implements the password-based key derivation
	  function, PBKDF2, specified in RSA PKCS#5 v2.0.

	  http://www.dlitz.net/software/python-pbkdf2/
```

## rpi/package/python-psycopg2/Config.in
```kconfig
config BR2_PACKAGE_PYTHON_PSYCOPG2
	bool "python-psycopg2"
	depends on BR2_PACKAGE_PYTHON || BR2_PACKAGE_PYTHON3
	select BR2_PACKAGE_POSTGRESQL_95
	help
	  Psycopg is the most popular PostgreSQL database adapter for the Python
	  programming language. Its main features are the complete implementation
	  of the Python DB API 2.0 specification and the thread safety (several
	  threads can share the same connection).
	  
	  http://initd.org/psycopg/
```

## rpi/package/python-pyyaml/Config.in
```kconfig
config BR2_PACKAGE_PYTHON_PYYAML
	bool "python-pyyaml"
	depends on BR2_PACKAGE_PYTHON || BR2_PACKAGE_PYTHON3
	help
	  YAML is a data serialization format designed for human readability and
	  interaction with scripting languages. PyYAML is a YAML parser and emitter
	  for Python.

	  https://pypi.python.org/pypi/PyYAML/
```

## rpi/package/python-scandir/Config.in
```kconfig
config BR2_PACKAGE_PYTHON_SCANDIR
	bool "python-scandir"
	depends on BR2_PACKAGE_PYTHON || BR2_PACKAGE_PYTHON3
	help
      scandir is a module which provides a generator version of os.listdir()
      that also exposes the extra file information the operating system returns
      when you iterate a directory. scandir also provides a much faster version
      of os.walk(), because it can use the extra file information exposed by
      the scandir() function.

      https://github.com/benhoyt/scandir
```

## rpi/package/python-sqlize-pg/Config.in
```kconfig
config BR2_PACKAGE_PYTHON_SQLIZE_PG
	bool "python-sqlize-pg"
	depends on BR2_PACKAGE_PYTHON || BR2_PACKAGE_PYTHON3
	help
	  Fast SQL query builder for Python

	  https://github.com/Outernet-project/sqlize
```

## rpi/package/python-sqlize/Config.in
```kconfig
config BR2_PACKAGE_PYTHON_SQLIZE
	bool "python-sqlize"
	depends on BR2_PACKAGE_PYTHON || BR2_PACKAGE_PYTHON3
	help
	  Fast SQL query builder for Python

	  https://github.com/Outernet-project/sqlize
```

## rpi/package/python-ua-parser/Config.in
```kconfig
config BR2_PACKAGE_PYTHON_UA_PARSER
	bool "python-ua-parser"
	depends on BR2_PACKAGE_PYTHON || BR2_PACKAGE_PYTHON3
	select BR2_PACKAGE_PYTHON_PYYAML
	help
	  A python implementation of the UA Parser.

	  https://github.com/ua-parser/uap-python
```

## rpi/package/python-zippie/Config.in
```kconfig
config BR2_PACKAGE_PYTHON_ZIPPIE
	bool "python-zippie"
	depends on BR2_PACKAGE_PYTHON || BR2_PACKAGE_PYTHON3
	help
	  A zip archive handler tool, attempting to achieve API compatibility with
	  Pythons own zipfile module.

	  https://github.com/integricho/zippie
```

## rpi2/configs/orx_defconfig
```kconfig
BR2_arm=y
BR2_cortex_a7=y
BR2_ARM_FPU_NEON_VFPV4=y
BR2_KERNEL_HEADERS_4_1=y
BR2_TOOLCHAIN_BUILDROOT_GLIBC=y
BR2_TOOLCHAIN_BUILDROOT_CXX=y
BR2_GENERATE_LOCALE="en_US"
BR2_TARGET_GENERIC_HOSTNAME="orxpi2"
BR2_TARGET_GENERIC_ISSUE="Welcome to Outernet"
BR2_ROOTFS_DEVICE_CREATION_DYNAMIC_EUDEV=y
BR2_TARGET_GENERIC_ROOT_PASSWD="outernet"
BR2_TARGET_GENERIC_GETTY_PORT="tty1"
BR2_TARGET_TZ_INFO=y
BR2_ROOTFS_USERS_TABLES="$(BR2_EXTERNAL)/users"
BR2_ROOTFS_OVERLAY="$(BR2_EXTERNAL)/rootfs_overlay $(BR2_EXTERNAL)/rootfs_overlay_rpi2"
BR2_ROOTFS_POST_BUILD_SCRIPT="$(BR2_EXTERNAL)/scripts/post_build.sh"
BR2_ROOTFS_POST_IMAGE_SCRIPT="$(BR2_EXTERNAL)/scripts/post_image.sh"
BR2_LINUX_KERNEL=y
BR2_LINUX_KERNEL_CUSTOM_GIT=y
BR2_LINUX_KERNEL_CUSTOM_REPO_URL="https://github.com/raspberrypi/linux.git"
BR2_LINUX_KERNEL_CUSTOM_REPO_VERSION="0aa6fa69a7874060590c8cb4fabdb9a222501a08"
BR2_LINUX_KERNEL_USE_CUSTOM_CONFIG=y
BR2_LINUX_KERNEL_CUSTOM_CONFIG_FILE="$(BR2_EXTERNAL)/configs/kernel_defconfig"
BR2_LINUX_KERNEL_ZIMAGE=y
BR2_LINUX_KERNEL_DTS_SUPPORT=y
BR2_LINUX_KERNEL_INTREE_DTS_NAME="bcm2709-rpi-2-b"
BR2_PACKAGE_BUSYBOX_CONFIG="$(BR2_EXTERNAL)/configs/busybox.config"
BR2_PACKAGE_NTFS_3G=y
BR2_PACKAGE_B43_FIRMWARE=y
BR2_PACKAGE_LINUX_FIRMWARE=y
BR2_PACKAGE_LINUX_FIRMWARE_ATHEROS_6002=y
BR2_PACKAGE_LINUX_FIRMWARE_ATHEROS_6003=y
BR2_PACKAGE_LINUX_FIRMWARE_ATHEROS_6004=y
BR2_PACKAGE_LINUX_FIRMWARE_ATHEROS_7010=y
BR2_PACKAGE_LINUX_FIRMWARE_ATHEROS_9170=y
BR2_PACKAGE_LINUX_FIRMWARE_ATHEROS_9271=y
BR2_PACKAGE_LINUX_FIRMWARE_BRCM_BCM43XX=y
BR2_PACKAGE_LINUX_FIRMWARE_BRCM_BCM43XXX=y
BR2_PACKAGE_LINUX_FIRMWARE_IWLWIFI_3160=y
BR2_PACKAGE_LINUX_FIRMWARE_IWLWIFI_5000=y
BR2_PACKAGE_LINUX_FIRMWARE_IWLWIFI_6000G2A=y
BR2_PACKAGE_LINUX_FIRMWARE_IWLWIFI_7260=y
BR2_PACKAGE_LINUX_FIRMWARE_IWLWIFI_7265=y
BR2_PACKAGE_LINUX_FIRMWARE_LIBERTAS_SD8686_V8=y
BR2_PACKAGE_LINUX_FIRMWARE_LIBERTAS_SD8686_V9=y
BR2_PACKAGE_LINUX_FIRMWARE_LIBERTAS_SD8688=y
BR2_PACKAGE_LINUX_FIRMWARE_MWIFIEX_SD8787=y
BR2_PACKAGE_LINUX_FIRMWARE_RALINK_RT61=y
BR2_PACKAGE_LINUX_FIRMWARE_RALINK_RT73=y
BR2_PACKAGE_LINUX_FIRMWARE_RALINK_RT2XX=y
BR2_PACKAGE_LINUX_FIRMWARE_RTL_81XX=y
BR2_PACKAGE_LINUX_FIRMWARE_RTL_87XX=y
BR2_PACKAGE_LINUX_FIRMWARE_RTL_88XX=y
BR2_PACKAGE_LINUX_FIRMWARE_TI_WL127X=y
BR2_PACKAGE_LINUX_FIRMWARE_TI_WL128X=y
BR2_PACKAGE_LINUX_FIRMWARE_TI_WL18XX=y
BR2_PACKAGE_RPI_FIRMWARE=y
# BR2_PACKAGE_RPI_FIRMWARE_INSTALL_DTB_OVERLAYS is not set
BR2_PACKAGE_PYTHON=y
BR2_PACKAGE_PYTHON_PY_ONLY=y
BR2_PACKAGE_PYTHON_MARKUPSAFE=y
BR2_PACKAGE_LIGHTTPD=y
BR2_PACKAGE_LIGHTTPD_PCRE=y
BR2_PACKAGE_CPULOAD=y
BR2_PACKAGE_HTOP=y
BR2_TARGET_ROOTFS_INITRAMFS=y
# BR2_TARGET_ROOTFS_TAR is not set
BR2_PACKAGE_PYTHON_LIBRARIAN=y
BR2_PACKAGE_PYTHON_LIBRARIAN_UI=y
BR2_PACKAGE_PYTHON_LIBRARIAN_LOGS=y
BR2_PACKAGE_PYTHON_LIBRARIAN_ONDD=y
BR2_PACKAGE_PYTHON_LIBRARIAN_DISKSPACE=y
BR2_PACKAGE_PYTHON_LIBRARIAN_NETINTERFACES=y
BR2_PACKAGE_PYTHON_LIBRARIAN_LIBRARY=y
BR2_PACKAGE_PYTHON_LIBRARIAN_TWITTER=y
BR2_PACKAGE_PYTHON_LIBRARIAN_OPENER_HTML=y
BR2_PACKAGE_PYTHON_LIBRARIAN_OPENER_VIDEO=y
BR2_PACKAGE_PYTHON_LIBRARIAN_CAPTIVE=y
BR2_PACKAGE_MONITORING=y
```

## sdcard/Config.in
```kconfig
menu "Librarian"
	source "$BR2_EXTERNAL/package/python-librarian/Config.in"
if BR2_PACKAGE_PYTHON_LIBRARIAN
comment "Base framework"
	source "$BR2_EXTERNAL/package/python-librarian-core/Config.in"
	source "$BR2_EXTERNAL/package/python-librarian-notifications/Config.in"
	source "$BR2_EXTERNAL/package/python-librarian-content/Config.in"
	source "$BR2_EXTERNAL/package/python-librarian-setup/Config.in"
	source "$BR2_EXTERNAL/package/python-librarian-auth/Config.in"
	source "$BR2_EXTERNAL/package/python-librarian-dashboard/Config.in"
	source "$BR2_EXTERNAL/package/python-librarian-menu/Config.in"
comment "UI skins"
	source "$BR2_EXTERNAL/package/python-librarian-ui/Config.in"
comment "Settings plugins"
	source "$BR2_EXTERNAL/package/python-librarian-logs/Config.in"
	source "$BR2_EXTERNAL/package/python-librarian-ondd/Config.in"
	source "$BR2_EXTERNAL/package/python-librarian-diskspace/Config.in"
	source "$BR2_EXTERNAL/package/python-librarian-netinterfaces/Config.in"
	source "$BR2_EXTERNAL/package/python-librarian-settings/Config.in"
comment "Apps"
	source "$BR2_EXTERNAL/package/python-librarian-filemanager/Config.in"
	source "$BR2_EXTERNAL/package/python-librarian-library/Config.in"
	source "$BR2_EXTERNAL/package/python-librarian-twitter/Config.in"
comment "Content openers"
	source "$BR2_EXTERNAL/package/python-librarian-opener-html/Config.in"
	source "$BR2_EXTERNAL/package/python-librarian-opener-video/Config.in"
comment "Misc"
	source "$BR2_EXTERNAL/package/python-librarian-analytics/Config.in"
	source "$BR2_EXTERNAL/package/python-librarian-captive/Config.in"
endif
comment "Monitoring and reporting"
	source "$BR2_EXTERNAL/package/monitoring/Config.in"
endmenu

menu "Dependencies"
    source "$BR2_EXTERNAL/package/lighttpd-custom/Config.in"
    source "$BR2_EXTERNAL/package/postgresql-95/Config.in"
    source "$BR2_EXTERNAL/package/python-bitarray/Config.in"
    source "$BR2_EXTERNAL/package/python-bottle-fdsend/Config.in"
    source "$BR2_EXTERNAL/package/python-bottle-utils/Config.in"
    source "$BR2_EXTERNAL/package/python-chainable-validators/Config.in"
    source "$BR2_EXTERNAL/package/python-cssmin/Config.in"
    source "$BR2_EXTERNAL/package/python-dateutil/Config.in"
    source "$BR2_EXTERNAL/package/python-fsal/Config.in"
    source "$BR2_EXTERNAL/package/python-gevent/Config.in"
    source "$BR2_EXTERNAL/package/python-greenlet/Config.in"
    source "$BR2_EXTERNAL/package/python-greentasks/Config.in"
    source "$BR2_EXTERNAL/package/python-hwd/Config.in"
    source "$BR2_EXTERNAL/package/python-ondd-ipc/Config.in"
    source "$BR2_EXTERNAL/package/python-outernet-metadata/Config.in"
    source "$BR2_EXTERNAL/package/python-pbkdf2/Config.in"
    source "$BR2_EXTERNAL/package/python-pyhostapdconf/Config.in"
    source "$BR2_EXTERNAL/package/python-pytz/Config.in"
    source "$BR2_EXTERNAL/package/python-pyudev/Config.in"
    source "$BR2_EXTERNAL/package/python-scandir/Config.in"
    source "$BR2_EXTERNAL/package/python-sqlize-pg/Config.in"
    source "$BR2_EXTERNAL/package/python-squery-pg/Config.in"
    source "$BR2_EXTERNAL/package/python-webassets/Config.in"
    source "$BR2_EXTERNAL/package/python-psycopg2/Config.in"
    source "$BR2_EXTERNAL/package/python-ua-parser/Config.in"
    source "$BR2_EXTERNAL/package/python-user-agents/Config.in"
    source "$BR2_EXTERNAL/package/python-zippie/Config.in"
endmenu

menu "Development"
comment "The packages in this section are only required for building binaries "
comment "for code that is closed-source. Do not enable them for normal builds."
	source "$BR2_EXTERNAL/package/ondd/Config.in"
endmenu
```

## sdcard/package/python-beautifulsoup4/Config.in
```kconfig
config BR2_PACKAGE_PYTHON_BEAUTIFULSOUP4
	bool "python-beautifulsoup4"
	depends on BR2_PACKAGE_PYTHON || BR2_PACKAGE_PYTHON3
	help
	  Beautiful Soup sits atop an HTML or XML parser, providing Pythonic idioms
	  for iterating, searching, and modifying the parse tree.

	  http://www.crummy.com/software/BeautifulSoup/bs4/
```

## sdcard/package/python-bottle-fdsend/Config.in
```kconfig
config BR2_PACKAGE_PYTHON_BOTTLE_FDSEND
	bool "python-bottle-fdsend"
	depends on BR2_PACKAGE_PYTHON_BOTTLE
	help
	  This package implements functions for constructing bottle's
	  HTTPResponse objects from file handles.

	  https://github.com/Outernet-Project/bottle-fdsend
```

## sdcard/package/python-chainable-validators/Config.in
```kconfig
config BR2_PACKAGE_PYTHON_CHAINABLE_VALIDATORS
	bool "python-chainable-validators"
	depends on BR2_PACKAGE_PYTHON || BR2_PACKAGE_PYTHON3
	help
	  Library for writing chainable validation functions.

	  https://github.com/Outernet-Project/chainable-validators
```

## sdcard/package/python-confloader/Config.in
```kconfig
config BR2_PACKAGE_PYTHON_CONFLOADER
	bool "python-confloader"
	depends on BR2_PACKAGE_PYTHON || BR2_PACKAGE_PYTHON3
	help
	  Python module for loading .ini configuration files with extra bells and 
	  whistles

	  http://confloader.readthedocs.org/
```

## sdcard/package/python-cssmin/Config.in
```kconfig
config BR2_PACKAGE_PYTHON_CSSMIN
	bool "python-cssmin"
	depends on BR2_PACKAGE_PYTHON || BR2_PACKAGE_PYTHON3
	help
	  A Python port of the YUI CSS compression algorithm.
	  
	  http://github.com/zacharyvoase/cssmin
```

## sdcard/package/python-dateutil/Config.in
```kconfig
config BR2_PACKAGE_PYTHON_DATEUTIL
	bool "python-dateutil"
	depends on BR2_PACKAGE_PYTHON
	select BR2_PACKAGE_PYTHON_SIX
	help
	  The dateutil module provides powerful extensions to the datetime
	  module available in the Python standard library.

	  https://dateutil.readthedocs.org/
```

## sdcard/package/python-greenlet/Config.in
```kconfig
config BR2_PACKAGE_PYTHON_GREENLET
	bool "python-greenlet"
	depends on BR2_PACKAGE_PYTHON || BR2_PACKAGE_PYTHON3
	help
	  The greenlet package is a spin-off of Stackless, a version of
	  CPython that supports micro-threads called "tasklets". Tasklets
	  run pseudo-concurrently (typically in a single or a few OS-level
	  threads) and are synchronized with data exchanges on "channels".

	  https://github.com/python-greenlet/greenlet
```

## sdcard/package/python-greentasks/Config.in
```kconfig
config BR2_PACKAGE_PYTHON_GREENTASKS
	bool "python-greentasks"
	depends on BR2_PACKAGE_PYTHON
	select BR2_PACKAGE_PYTHON_GEVENT
	help
	  A very simplistic task scheduler built around gevent.

	  https://github.com/Outernet-Project/greentasks/
```

## sdcard/package/python-hachoir-core/Config.in
```kconfig
config BR2_PACKAGE_PYTHON_HACHOIR_CORE
	bool "python-hachoir-core"
	depends on BR2_PACKAGE_PYTHON || BR2_PACKAGE_PYTHON3
	help
	  Hachoir is a Python library used to represent of a binary file as a tree
	  of Python objects. Each object has a type, a value, an address, etc. The
	  goal is to be able to know the meaning of each bit in a file.

	  https://bitbucket.org/haypo/hachoir
```

## sdcard/package/python-hachoir-metadata/Config.in
```kconfig
config BR2_PACKAGE_PYTHON_HACHOIR_METADATA
	bool "python-hachoir-metadata"
	depends on BR2_PACKAGE_PYTHON || BR2_PACKAGE_PYTHON3
	select BR2_PACKAGE_PYTHON_HACHOIR_CORE
	help
	  Hachoir is a Python library used to represent of a binary file as a tree
	  of Python objects. Each object has a type, a value, an address, etc. The
	  goal is to be able to know the meaning of each bit in a file.

	  https://bitbucket.org/haypo/hachoir
```

## sdcard/package/python-hwd/Config.in
```kconfig
config BR2_PACKAGE_PYTHON_HWD
	bool "python-hwd"
	depends on BR2_PACKAGE_PYTHON || BR2_PACKAGE_PYTHON3
    select BR2_PACKAGE_PYTHON_NETIFACES
    select BR2_PACKAGE_PYTHON_PYUDEV
	help
      hwd wraps around pyudev‘s Device objects to provide functionality
      specific to different types of hardware. 

	  https://github.com/Outernet-Project/hwd
```
